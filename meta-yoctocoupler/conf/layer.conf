## meta-yoctocoupler/conf/layer.conf
```bitbake
BBPATH .= ":${LAYERDIR}"

BBFILES += "${LAYERDIR}/recipes-*/*/*.bb \
            ${LAYERDIR}/recipes-*/*/*.bbappend"

BBFILE_COLLECTIONS += "yoctocoupler"
BBFILE_PATTERN_yoctocoupler := "^${LAYERDIR}/"
BBFILE_PRIORITY_yoctocoupler = "20"

LAYERDEPENDS_yoctocoupler = "core raspberrypi openembedded-layer"
LAYERSERIES_COMPAT_yoctocoupler = "scarthgap"
```
